## boards/shields/lily58_choc/Kconfig.shield
```kconfig
# No whitespace after the comma or in the keyboard name!
config SHIELD_LILY58_CHOC_DONGLE
    def_bool $(shields_list_contains,lily58_choc_dongle)
```
